/* Variable definitions for ESP32ULP linker
 * This file is generated automatically by esp32ulp_mapgen.py utility.
 */

PROVIDE ( ulp_ant_edge = 0x500000d0 );
PROVIDE ( ulp_changed = 0x50000054 );
PROVIDE ( ulp_debounce_counter = 0x500000d4 );
PROVIDE ( ulp_debounce_max_count = 0x500000d8 );
PROVIDE ( ulp_edge_count = 0x500000dc );
PROVIDE ( ulp_edge_count_to_wake_up = 0x500000e0 );
PROVIDE ( ulp_edge_detected = 0x50000070 );
PROVIDE ( ulp_entry = 0x50000000 );
PROVIDE ( ulp_io_number = 0x500000e4 );
PROVIDE ( ulp_next_edge = 0x500000cc );
PROVIDE ( ulp_wake_up = 0x500000b8 );
